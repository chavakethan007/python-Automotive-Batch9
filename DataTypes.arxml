AUTOSAR XML (schema 4-2-2)
standard types defined: uint8, uint8_DataConstr
