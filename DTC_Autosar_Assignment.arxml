AUTOSAR XML (schema 4-2-2)
package /Application
  application sw component type DTC_Manager
    behavior DTC_Manager_InternalBehavior
  swc implementation DTC_Manager_Implementation: behavior=DTC_Manager_InternalBehavior
